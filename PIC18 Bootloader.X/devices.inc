#ifdef __18F25K20
     #define DEVICEID                .259
     #define WRITE_FLASH_BLOCKSIZE   .32
     #define ERASE_FLASH_BLOCKSIZE   .64
     #define END_FLASH               0x8000
     #define END_GPR                 0x600
#endif

#ifdef __18F25K22
     #define DEVICEID                .682
     #define WRITE_FLASH_BLOCKSIZE   .64
     #define ERASE_FLASH_BLOCKSIZE   .64
     #define END_FLASH               0x8000
     #define END_GPR                 0x600
#endif

#ifdef __18F25K80
     #define DEVICEID                .780
     #define WRITE_FLASH_BLOCKSIZE   .64
     #define ERASE_FLASH_BLOCKSIZE   .64
     #define END_FLASH               0x8000
     #define END_GPR                 0xE41
#endif

#ifdef __18F26K20
     #define DEVICEID                .257
     #define WRITE_FLASH_BLOCKSIZE   .64
     #define ERASE_FLASH_BLOCKSIZE   .64
     #define END_FLASH               0x10000
     #define END_GPR                 0xF60
#endif

#ifdef __18F26K22
     #define DEVICEID                .674
     #define WRITE_FLASH_BLOCKSIZE   .64
     #define ERASE_FLASH_BLOCKSIZE   .64
     #define END_FLASH               0x10000
     #define END_GPR                 0xF38
#endif

#ifdef __18F26K80
     #define DEVICEID                .777
     #define WRITE_FLASH_BLOCKSIZE   .64
     #define ERASE_FLASH_BLOCKSIZE   .64
     #define END_FLASH               0x10000
     #define END_GPR                 0xE41
#endif

#ifdef __18F45K20
     #define DEVICEID                .258
     #define WRITE_FLASH_BLOCKSIZE   .32
     #define ERASE_FLASH_BLOCKSIZE   .64
     #define END_FLASH               0x8000
     #define END_GPR                 0x600
#endif

#ifdef __18F45K22
     #define DEVICEID                .680
     #define WRITE_FLASH_BLOCKSIZE   .64
     #define ERASE_FLASH_BLOCKSIZE   .64
     #define END_FLASH               0x8000
     #define END_GPR                 0x600
#endif

#ifdef __18F45K80
     #define DEVICEID                .779
     #define WRITE_FLASH_BLOCKSIZE   .64
     #define ERASE_FLASH_BLOCKSIZE   .64
     #define END_FLASH               0x8000
     #define END_GPR                 0xE41
#endif

#ifdef __18F46K20
     #define DEVICEID                .256
     #define WRITE_FLASH_BLOCKSIZE   .64
     #define ERASE_FLASH_BLOCKSIZE   .64
     #define END_FLASH               0x10000
     #define END_GPR                 0xF60
#endif

#ifdef __18F46K22
     #define DEVICEID                .672
     #define WRITE_FLASH_BLOCKSIZE   .64
     #define ERASE_FLASH_BLOCKSIZE   .64
     #define END_FLASH               0x10000
     #define END_GPR                 0xF38
#endif

#ifdef __18F46K80
     #define DEVICEID                .776
     #define WRITE_FLASH_BLOCKSIZE   .64
     #define ERASE_FLASH_BLOCKSIZE   .64
     #define END_FLASH               0x10000
     #define END_GPR                 0xE41
#endif


